#include <ESP8266WiFi.h>
#include <BlynkSimpleEsp8266.h>
#include <OneWire.h>
#include <DallasTemperature.h>

#ifndef UNIT_TEST
#include <Arduino.h>
#endif
#include <IRremoteESP8266.h>
#include <IRsend.h>

#define ONE_WIRE_BUS 2

const uint16_t kIrLed = 4; // ESP8266 GPIO pin to use. Recommended: 4 (D2).
uint8_t sensor1[8] = {0x28, 0xBB, 0x27, 0x79, 0x97, 0x08, 0x03, 0xB5};

IRsend irsend(kIrLed); // Set the GPIO to be used to sending the message.

uint16_t generalOff[197] = {
    6148, 7350, 534, 1660, 580, 1628, 570, 1620, 528, 1682, 570, 1618,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 7350, 530};

uint16_t heat28c[197] = {
    6148, 7330, 602, 1594, 530, 1670, 574, 1634, 596, 1540, 652, 1592,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 7388, 572};

uint16_t cool22c[197] = {
    6140, 7354, 528, 1680, 612, 1572, 534, 1660, 588, 1618, 570, 1620,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 7442, 568};

OneWire oneWire(ONE_WIRE_BUS);
DallasTemperature sensors(&oneWire);

// blynk token
char auth[] = "00000000000000000000000000";

char ssid[] = "SSID";
char pass[] = "PASSWORD";
int cool = 0;
int heat = 0;
int turnOff = 0;

BLYNK_WRITE(V0)
{
  if (param.asInt())
    cool = 1;
  else
    cool = 0;
}

BLYNK_WRITE(V1)
{
  if (param.asInt())
    heat = 1;
  else
    heat = 0;
}

BLYNK_WRITE(V3)
{
  if (param.asInt())
    turnOff = 1;
  else
    turnOff = 0;
}

void setup()
{
  Serial.begin(115200, SERIAL_8N1, SERIAL_TX_ONLY);
  sensors.begin();
  irsend.begin();
  Blynk.begin(auth, ssid, pass);
}

void loop()
{
  sensors.requestTemperatures();
  Blynk.run();
  Blynk.virtualWrite(V2, (int)round(sensors.getTempC(sensor1)));

  if (cool)
  {
    irsend.sendRaw(cool22c, 197, 38);
    delay(5000);
  }

  if (heat)
  {
    irsend.sendRaw(heat28c, 197, 38);
    delay(5000);
  }

  if (turnOff)
  {
    irsend.sendRaw(generalOff, 197, 38);
    delay(5000);
  }

  delay(100);
}
